## conf/distro/zondbox-distro.conf
```bitbake
require conf/distro/poky.conf
DISTRO = "zondbox-distro"

MAINTAINER = "<juan.leni@zondax.ch>"

POKY_DEFAULT_EXTRA_RDEPENDS = ""
POKY_DEFAULT_EXTRA_RRECOMMENDS = ""

POKY_DISTRO_FEATURES  = "alsa ipv4 ipv6 largefile sysvinit xattr optee"
DISTRO_FEATURES = "${DISTRO_FEATURES_LIBC_DEFAULT} ${POKY_DISTRO_FEATURES}"
TCLIBCAPPEND = ""

VIRTUAL-RUNTIME_init_manager = "sysvinit"
PACKAGE_CLASSES ?= "package_ipk"

ROOT_HOME = "/root"

INHERIT += "image-buildinfo"
IMAGE_BUILDINFO_VARS = "MACHINE DISTRO DISTRO_VERSION IMAGE_BASENAME DATETIME"
```

## conf/layer.conf
```bitbake
# We have a conf and classes directory, add to BBPATH
BBPATH .= ":${LAYERDIR}"

# We have recipes-* directories, add to BBFILES
BBFILES += "${LAYERDIR}/recipes-*/*/*.bb \
            ${LAYERDIR}/recipes-*/*/*.bbappend"

BBFILE_COLLECTIONS += "meta-zondax"
BBFILE_PATTERN_meta-zondax = "^${LAYERDIR}/"
BBFILE_PRIORITY_meta-zondax = "15"

LAYERDEPENDS_meta-zondax = "core"
LAYERSERIES_COMPAT_meta-zondax = "honister"

PREFERRED_VERSION_optee-test = "3.14.0%"
PREFERRED_VERSION_optee-client = "3.14.0%"
PREFERRED_VERSION_optee-examples = "3.14.0%"

IMAGE_INSTALL:append += " \
    ${@bb.utils.contains('DISTRO_FEATURES', 'optee', 'packagegroup-optee-core', '', d)} \
    ${@bb.utils.contains('DISTRO_FEATURES', 'optee', 'packagegroup-optee-examples', '', d)} \
    ${@bb.utils.contains('DISTRO_FEATURES', 'optee', 'packagegroup-optee-test', '', d)} \
    ${@bb.utils.contains('DISTRO_FEATURES', 'optee', 'tee-substrate-service', '', d)} \
    ${@bb.utils.contains('DISTRO_FEATURES', 'optee', 'hello-rustee', '', d)} \
    packagegroup-core-ssh-openssh \
    "
DISTRO_FEATURES:append= " x11"
EXTRA_IMAGE_FEATURES:append = " x11 debug-tweaks "
```
